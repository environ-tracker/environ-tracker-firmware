## boards/arm/environ-tracker/Kconfig.board
```kconfig
config BOARD_ENVIRON_TRACKER_V1
	bool "Environ Tracker V1"
	depends on SOC_NRF52833_QIAA
```

## boards/arm/environ-tracker/Kconfig.defconfig
```kconfig
if BOARD_ENVIRON_TRACKER_V1

config BOARD
	default "environ-tracker-v1"

config BT_CTLR
	default BT

endif # BOARD_ENVIRON_TRACKER_V1
```

## boards/arm/environ_tracker/Kconfig.board
```kconfig
config BOARD_ENVIRON_TRACKER
	bool "Environ Tracker"
	depends on SOC_NRF52833_QIAA
```

## boards/arm/environ_tracker/Kconfig.defconfig
```kconfig
if BOARD_ENVIRON_TRACKER

config BOARD
	default "environ_tracker"

config BT_CTLR
	default BT

endif # BOARD_ENVIRON_TRACKER
```

## boards/arm/environ_tracker/environ_tracker_defconfig
```kconfig
CONFIG_SOC_SERIES_NRF52X=y
CONFIG_SOC_NRF52833_QIAA=y
CONFIG_BOARD_ENVIRON_TRACKER=y

CONFIG_ARM_MPU=y

CONFIG_GPIO=y

CONFIG_SERIAL=y

CONFIG_CONSOLE=y
CONFIG_UART_CONSOLE=y
```

## boards/arm/environ_tracker2/Kconfig.board
```kconfig
config BOARD_ENVIRON_TRACKER2
	bool "Environ Trackere"
	depends on SOC_NRF52833_QIAA
```

## boards/arm/environ_tracker2/Kconfig.defconfig
```kconfig
if BOARD_ENVIRON_TRACKER2

config BOARD
	default "environ_tracker2"

config BT_CTLR
	default BT

endif # BOARD_ENVIRON_TRACKER2
```

## boards/arm/environ_tracker2/environ_tracker2_defconfig
```kconfig
# Enable soc and board
CONFIG_SOC_SERIES_NRF52X=y
CONFIG_SOC_NRF52833_QIAA=y
CONFIG_BOARD_ENVIRON_TRACKER2=y

# Setup internal 32kHz RC clock to 250ppm accuracy
CONFIG_CLOCK_CONTROL_NRF_K32SRC_RC=y
CONFIG_CLOCK_CONTROL_NRF_K32SRC_250PPM=y

# Enable regulators
CONFIG_REGULATOR=y

# Enable MPU
CONFIG_ARM_MPU=y

# Enable GPIO
CONFIG_GPIO=y

# Enable UART driver
CONFIG_SERIAL=y

# Enable UART console
CONFIG_CONSOLE=y
CONFIG_UART_CONSOLE=y

# Enable pin control
CONFIG_PINCTRL=y
```

## boards/arm/environ_tracker_v2/Kconfig
```kconfig
# Environ Tracker v2 board configuration

if BOARD_ENVIRON_TRACKER_V2

config BOARD_MOTHER_VDD_PWR_CTRL_INIT_PRIORITY
    int "Motherboard VDD power rail init priority
    default 50
    depends on GPIO
    help
        Initialization priority for the motherboard VDD power rail. Has to be 
        greater than GPIO_INIT_PRIORITY.

endif # BOARD_ENVIRON_TRACKER_V2
```

## boards/arm/environ_tracker_v2/Kconfig.board
```kconfig
config BOARD_ENVIRON_TRACKER_V2
	bool "Environ Tracker v2"
	depends on SOC_NRF52833_QIAA
```

## boards/arm/environ_tracker_v2/Kconfig.defconfig
```kconfig
if BOARD_ENVIRON_TRACKER_V2

config BOARD
	default "environ_tracker_v2"

config BT_CTLR
	default BT

endif # BOARD_ENVIRON_TRACKER
```

## boards/shields/environ_tracker_daughterboard/Kconfig.shield
```kconfig
config SHIELD_ENVIRON_TRACKER_DAUGHTERBOARD
	def_bool $(shields_list_contains,environ_tracker_daughterboard)
```

## boards/shields/environ_tracker_daughterboard_v2/Kconfig.shield
```kconfig
config SHIELD_ENVIRON_TRACKER_DAUGHTERBOARD_V2
	def_bool $(shields_list_contains,environ_tracker_daughterboard_v2)

config CONFIG_BOARD_DAUGHTER_PWR_CTRL_INIT_PRIORITY
	int "Daughterboard power rail init priority"
	default 50
	depends on GPIO
	help
	  Initialization priority for the daughterboard power rail. Has to be greater than GPIO_INIT_PRIORITY
```

## drivers/Kconfig
```kconfig
menu "Drivers"
rsource "gpio/Kconfig"
rsource "sensor/Kconfig"
rsource "counter/Kconfig"
endmenu
```

## drivers/counter/Kconfig.rv3028
```kconfig
# RV3028 RTC COUNTER configuration options


DT_COMPAT_MICROCRYSTAL_RV3028 := microcrystal,rv3028

menuconfig RTC_RV3028
	bool "RV3028 I2C RTC chip"
	default $(dt_compat_enabled,$(DT_COMPAT_MICROCRYSTAL_RV3028))
	depends on I2C
	help
	  Enable driver for RV3028 I2C RTC chip.

if RTC_RV3028

endif # RTC_RV3028
```

## drivers/gpio/Kconfig.sx1502
```kconfig
# SX1502 GPIO configuration options

# Workaround for not being able to have commas in macro arguments
DT_COMPAT_SEMTECH_SX1502 := semtech,sx1502

menuconfig GPIO_SX1502
	bool "SX1502 I2C GPIO chip"
	default $(dt_compat_enabled,$(DT_COMPAT_SEMTECH_SX1502))
	depends on I2C
	help
	  Enable driver for SX1502 I2C GPIO chip.

if GPIO_SX1502

config GPIO_SX1502_INIT_PRIORITY
	int "Init priority"
	default 70
	help
	  Device driver initialization priority.

config GPIO_SX1502_INTERRUPT
	bool "Interrupt enable"
	default n
	help
	  Enable support for interrupts on GPIO pins.

endif # GPIO_SX1502
```

## drivers/gpio/Kconfig.sx1508b
```kconfig
# SX1509B GPIO configuration options

# Copyright (c) 2018 Aapo Vienamo
# SPDX-License-Identifier: Apache-2.0

# Workaround for not being able to have commas in macro arguments
DT_COMPAT_SEMTECH_SX1509B := semtech,sx1508b

menuconfig GPIO_SX1508B
	bool "SX1508B I2C GPIO chip"
	default $(dt_compat_enabled,$(DT_COMPAT_SEMTECH_SX1508B))
	depends on I2C
	help
	  Enable driver for SX1508B I2C GPIO chip.

if GPIO_SX1508B

config GPIO_SX1508B_INIT_PRIORITY
	int "Init priority"
	default 70
	help
	  Device driver initialization priority.

config GPIO_SX1508B_INTERRUPT
	bool "Interrupt enable"
	help
	  Enable support for interrupts on GPIO pins.

config GPIO_SX1508B_DEBOUNCE_TIME
	int "Debounce time interval"
	range 0 7
	default 0
	help
	  Debounce time interval when debounce enabled.

	  A value V produces a multiplier of 0.5 ms * 2^V, which is
	  then scaled by 2 MHz / fOSC.  See the datasheet for details.

endif # GPIO_SX1508B
```

## drivers/sensor/lc709204f/Kconfig
```kconfig
menuconfig LC709204F
	bool "LC709204F Li-ion/Li+ Battery Fuel Gauge"
	depends on I2C
	help
	  Enable I2C-based driver for LC709204F Li-ion/Li+ Battery Fuel Gauge.

if LC709204F

choice LC709204F_TRIGGER_MODE
	prompt "Trigger mode"
	help
		Specify the type of triggering to be used by the driver.

config LC709204F_TRIGGER_NONE
	bool "No trigger"

config LC709204F_TRIGGER_GLOBAL_THREAD
	bool "Use global thread"
	depends on GPIO
	select LC709204F_TRIGGER

config LC709204F_TRIGGER_OWN_THREAD
	bool "Use own thread"
	depends on GPIO
	select LC709204F_TRIGGER

endchoice

config LC709204F_TRIGGER
	bool

if LC709204F_TRIGGER

config LC709204F_THREAD_PRIORITY
	int "Thread priority"
	depends on LC709204F_TRIGGER_OWN_THREAD
	default 10
	help
	  Priority of thread used by the driver to handle interrupts.

endif # LC709204F_TRIGGER

endif # LC709204F
```

## drivers/sensor/si1132/Kconfig
```kconfig
config SI1132
	bool "Si1132 Visible, IR and UV Light Sensor"
	depends on I2C
	help
		Enable I2C-based driver for Si1132 Visible, IR and UV Light Sensor.
```

## dts/bindings/gpio/environ-tracker-header.yaml
```yaml
description: |
  Board connections exposed on the environ-tracker-v1 board.

  0 HAT_ADC
  1 HAT_INT

compatible: "environ-tracker-header"

include: [gpio-nexus.yaml, base.yaml]
```
