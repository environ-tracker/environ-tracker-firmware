## dts/bindings/gpio/semtech,sx1502.yaml
```yaml
description: SX1502 GPIO node

compatible: "semtech,sx1502"

include: [i2c-device.yaml, gpio-controller.yaml]

properties:
    label:
      required: true

    "#gpio-cells":
      const: 2

    ngpios:
      required: true
      const: 8

    nint-gpios:
      type: phandle-array
      required: false
      description: |
        Connection for the NINT signal. This signal is active-low when
        produced by sx1502 GPIO node.

    init-out-low:
      type: int
      required: false
      default: 0
      description: |
        Bit mask identifying pins that should be initialized as outputs
        driven low.

    init-out-high:
      type: int
      required: false
      default: 0
      description: |
        Bit mask identifying pins that should be initialized as outputs
        driven high.

gpio-cells:
  - pin
  - flags
```

## dts/bindings/gpio/semtech,sx1508b.yaml
```yaml
# Copyright (c) 2018, Aapo Vienamo
# SPDX-License-Identifier: Apache-2.0

description: SX1508B GPIO node

compatible: "semtech,sx1508b"

include: [i2c-device.yaml, gpio-controller.yaml]

properties:
    label:
      required: true

    "#gpio-cells":
      const: 2

    ngpios:
      required: true
      const: 8

    nint-gpios:
      type: phandle-array
      required: false
      description: |
        Connection for the NINT signal. This signal is active-low when
        produced by sx1508b GPIO node.

    init-out-low:
      type: int
      required: false
      default: 0
      description: |
        Bit mask identifying pins that should be initialized as outputs
        driven low.

    init-out-high:
      type: int
      required: false
      default: 0
      description: |
        Bit mask identifying pins that should be initialized as outputs
        driven high.

gpio-cells:
  - pin
  - flags
```

## dts/bindings/rtc/microcrystal,rv3028.yaml
```yaml
description: RV3028 I2C RTC

compatible: "microcrystal,rv3028"

include: i2c-device.yaml

properties:
  reg:
    required: true

  int-gpios:
    type: phandle-array
    required: false
    description: |
      NOTE: Not implemented
      Connection for the NINT signal. This signal is used by the RV3028 for 
      interrupt notification. It is active-low.

  evt-gpios:
    type: phandle-array
    required: false
    description: |
      NOTE: Not implemented
      Connection for the EVT signal. Used to supply the RV3028 with events

  clkout-gpios:
    type: phandle-array
    required: false
    description: |
      NOTE: Not implemented
      Connection for the CLKOUT signal.
```

## dts/bindings/sensor/onsemi,lc709204f.yaml
```yaml
description: |
  Onsemi Li-ion/Li+ battery fuel gauge.

compatible: "onsemi,lc709204f"

include: i2c-device.yaml

properties:

  design-capacity:
    type: int
    required: true
    description: The label capacity of the cell in mAh

  design-voltage:
    type: int
    required: true
    description: The label voltage of the cell in mV

  desired-voltage:
    type: int
    required: true
    description: The desired voltage of the cell in mV

  empty-voltage:
    type: int
    required: true
    description: The empty voltage of the cell in mV

  desired-charging-current:
    type: int
    required: true
    description: The desired charging current of the cell in mA

  chg-term-current:
    type: int
    required: true
    description: The charge termination current in uA

  apa-value:
    type: int
    required: true
    description: Adjustment Pack Application values. Used to adjust gauge to
        connected battery

  battery-type:
    type: int
    enum: [1, 4, 5, 6, 7]
    required: true
    description: The type of battery being used. 
        (Must be one of [1, 4, 5, 6, 7])

  apt-value:
    type: int
    required: false
    description: NOT CURRENTLY SUPPORTED. Adjustment Pack Thermistor values. 
        Sets the delay time from turn-on to temperature measurement

  sense2-thermistor-b:
    type: int
    required: false
    description: NOT CURRENTLY SUPPORTED. The B-constant of the thermistor 
        connected to SENSE2

  sense1-thermistor-b:
    type: int
    required: false
    description: NOT CURRENTLY SUPPORTED. The B-constant of the thermistor 
        connected to SENSE2

  nint-gpios:
    type: phandle-array
    required: false
    description: Active low interrupt pin
```

## dts/bindings/sensor/silabs,si1132.yaml
```yaml
description: |
  Silabs visible, IR and UV light sensor.

compatible: "silabs,si1132"

include: i2c-device.yaml

properties:
  nint-gpios:
    type: phandle-array
    required: false
    description: Active low interrupt pin to be used
```

## samples/blinky/build/Kconfig/Kconfig.shield
```kconfig
osource "/home/ahelmore/thesis/environ-tracker/samples/blinky/../../boards/shields/*/Kconfig.shield"
```
