## CMakeLists.txt
```
cmake_minimum_required(VERSION 3.20.0)

set(CONF_FILE 
    prj.conf 
    sensors.conf
    shell.conf 
    ble.conf
    lora.conf
)

set(BOARD environ_tracker2)
set(SHIELD environ_tracker_daughterboard_v2)

find_package(Zephyr REQUIRED HINTS $ENV{ZEPHYR_BASE})
project(environ_tracker)

set(NANOPB_OPTIONS "-I${CMAKE_SOURCE_DIR}")
nanopb_generate_cpp(proto_sources proto_headers RELPATH .
    src/network/proto/upload_data.proto
)

zephyr_library_include_directories(${CMAKE_CURRENT_BINARY_DIR})
include_directories(inc inc/file inc/ble inc/network inc/gnss inc/gnss/ubx)


target_sources(app 
    PRIVATE 
        ${proto_sources}
        src/ble/ble_localisation.c
        src/shell.c 
        src/controller.c
        src/accumulator.c
        src/environ.c 
        src/imu.c 
        src/init/gpio_init.c
        src/init/log_init.c
        src/init/time_init.c
        src/file/file_init.c
        src/file/file_common.c
        src/network/lorawan.c
        src/network/encode_pb.c
        src/ble/ble_network.c
        src/gnss/gnss.c
        src/gnss/gnss_shell_cmds.c
        src/gnss/minmea.c
        src/gnss/ubx/u_ubx_protocol.c
        src/gui.c
)
```

## Kconfig
```
# Copyright (c) 2019 Peter Bigot Consulting, LLC
# SPDX-License-Identifier: Apache-2.0

mainmenu "applicaton settings"

config APP_WIPE_STORAGE
	bool "Option to clear the flash area before mounting"
	help
	  Use this to force an existing file system to be created.

config APP_INIT_BEACON_FILES
	bool "Option to initialise the iBeacon supported network files"
	help
	  Use this to enbale the initialisation of supported iBeacon network files.

config APP_FS_BACKEND_LOG_FILTER_LEVEL
	int "Option to set FS backend filter level"
	default 2
	help
	  Use this to set the filtering level of the FS logging backend.

source "Kconfig.zephyr"
```

## prj.conf
```kconfig
CONFIG_I2C=y

CONFIG_COUNTER=y
CONFIG_RTC_RV3028=y

CONFIG_GPIO=y
CONFIG_GPIO_SX1508B=y

# Enable reboot api
CONFIG_REBOOT=y

# Log settings
CONFIG_LOG=y
CONFIG_PRINTK=y

CONFIG_LOG_RUNTIME_FILTERING=y

CONFIG_SHELL_LOG_BACKEND=y

CONFIG_LOG_BACKEND_FS=y
CONFIG_LOG_BACKEND_FS_DIR="/lfs/logs"
CONFIG_LOG_BACKEND_FS_OUTPUT_TEXT=y
# CONFIG_LOG_BACKEND_FS_OUTPUT_DICTIONARY=y
CONFIG_LOG_BACKEND_FS_FILES_LIMIT=20

# Clock settings
CONFIG_CLOCK_CONTROL_NRF_K32SRC_RC=y
CONFIG_CLOCK_CONTROL_NRF_K32SRC_250PPM=y

# External flash settings
CONFIG_SPI=y
CONFIG_SPI_NOR=y
CONFIG_SPI_NOR_FLASH_LAYOUT_PAGE_SIZE=4096

# File System settings
CONFIG_FLASH=y
CONFIG_FLASH_MAP=y
CONFIG_FLASH_PAGE_LAYOUT=y

CONFIG_FILE_SYSTEM=y
CONFIG_FILE_SYSTEM_LITTLEFS=y
CONFIG_FILE_SYSTEM_SHELL=y
CONFIG_HEAP_MEM_POOL_SIZE=16384

CONFIG_FILE_SYSTEM_MAX_FILE_NAME=64

CONFIG_NRFX_SPIM1=y
CONFIG_NRFX_SPIM2=y
CONFIG_NRFX_TWIM0=y

CONFIG_NANOPB=y

CONFIG_EVENTS=y
CONFIG_POLL=y

CONFIG_DEBUG_THREAD_INFO=y

CONFIG_SERIAL=y
CONFIG_UART_INTERRUPT_DRIVEN=y

CONFIG_SSD1306=y
CONFIG_SSD1306_REVERSE_MODE=y
CONFIG_HEAP_MEM_POOL_SIZE=16384
CONFIG_DISPLAY=y
CONFIG_CHARACTER_FRAMEBUFFER=y
CONFIG_CFB_LOG_LEVEL_DBG=y

CONFIG_BT_RX_STACK_SIZE=2048
CONFIG_SYSTEM_WORKQUEUE_STACK_SIZE=2048
CONFIG_LOG_PROCESS_THREAD_STACK_SIZE=4096
```

## ble.conf
```kconfig
CONFIG_BT=y
CONFIG_BT_OBSERVER=y

# NOTE: to be removed in production
CONFIG_BT_DEBUG_LOG=y
```

## imu.conf
```kconfig
CONFIG_I2C=y
CONFIG_SX1052=y
CONFIG_SENSOR=y
CONFIG_LSM6DSO=y
CONFIG_LSM6DSO_TRIGGER_GLOBAL_THREAD=y
CONFIG_RING_BUFFER=y
```

## log.conf
```kconfig
CONFIG_LOG=y

CONFIG_SHELL_LOG_BACKEND=y
CONFIG_USE_SEGGER_RTT=y
CONFIG_LOG_BACKEND_RTT=y
```

## lora.conf
```kconfig
CONFIG_SPI=y
CONFIG_GPIO=y
CONFIG_LORA=y
CONFIG_LORA_SX12XX=y
CONFIG_LORA_SX126X=y
CONFIG_LORAWAN=y
CONFIG_LORAMAC_REGION_AU915=y

CONFIG_SYSTEM_WORKQUEUE_STACK_SIZE=2048

CONFIG_SETTINGS=y
CONFIG_NVS=y
CONFIG_SETTINGS_NVS=y
CONFIG_SETTINGS_FS=n
CONFIG_LORAWAN_NVM_SETTINGS=y
```

## sensors.conf
```kconfig
# Base sensor settings
CONFIG_I2C=y
CONFIG_SENSOR=y

# Base sensor settings
CONFIG_SI1132=y
CONFIG_LC709204F=y

# BME680 settings
CONFIG_BME680=y
CONFIG_BME680_PRESS_OVER_4X=y
CONFIG_BME680_FILTER_2=y

# LSM6DSO settings
CONFIG_LSM6DSO=y

# GPIO settings for interrupts
CONFIG_GPIO=y
CONFIG_GPIO_SX1508B=y
CONFIG_GPIO_SX1508B_INTERRUPT=y

# Thread settings for interrupts
CONFIG_LSM6DSO_TRIGGER_GLOBAL_THREAD=y

# Enable data construct
CONFIG_RING_BUFFER=y
```

## shell.conf
```kconfig
CONFIG_PRINTK=y

CONFIG_SHELL=y
CONFIG_KERNEL_SHELL=y
CONFIG_INIT_STACKS=y
CONFIG_THREAD_STACK_INFO=y
CONFIG_THREAD_MONITOR=y
CONFIG_THREAD_NAME=y
CONFIG_THREAD_RUNTIME_STATS=y
CONFIG_THREAD_RUNTIME_STATS_USE_TIMING_FUNCTIONS=y
CONFIG_DEVICE_SHELL=y
CONFIG_SHELL_HISTORY=y
CONFIG_BOOT_BANNER=y
CONFIG_SHELL_BACKEND_SERIAL=y
CONFIG_CONSOLE=y
CONFIG_POSIX_CLOCK=y
CONFIG_DATE_SHELL=y
```

## inc/accumulator.h
```c
#ifndef ACCUMULATOR_H
#define ACCUMULATOR_H

#include <zephyr/kernel.h>

#include "environ.h"
#include "imu.h"
#include "location.h"


#define ENVIRON_DATA_PENDING    1 << 0
#define ACTIVITY_DATA_PENDING   1 << 1
#define LOCATION_DATA_PENDING   1 << 2


struct system_data {
    uint32_t timestamp;
    struct environ_data environ;
    struct location_wrapper location;
    enum activity activity;
};

extern struct k_msgq gui_msgq;

extern struct k_msgq lorawan_msgq;

extern struct k_event data_events;

#endif /* ACCUMULATOR_H */
```

## inc/ble_localisation.h
```c
#ifndef BLE_LOCALISATION_H
#define BLE_LOCALISATION_H

#include <zephyr.h>

extern const k_tid_t ble_localisation_id;

extern struct k_msgq ibeacon_request_msgq;

#endif /* BLE_LOCALISATION_H */
```

## inc/controller.h
```c
#ifndef CONTROLLER_H
#define CONTROLLER_H

#include <zephyr/kernel.h>

#define SHORT_PRESS_EVENT   (1 << 0)
#define LONG_PRESS_EVENT    (1 << 4)

#define LEFT_BUTTON_SHORT_EVENT     (1 << 0)
#define RIGHT_BUTTON_SHORT_EVENT    (1 << 1)
#define SELECT_BUTTON_SHORT_EVENT   (1 << 2)
#define BUTTON_SHORT_EVENTS_ALL     (LEFT_BUTTON_SHORT_EVENT | \
                                     RIGHT_BUTTON_SHORT_EVENT | \
                                     SELECT_BUTTON_SHORT_EVENT)

#define LEFT_BUTTON_LONG_EVENT      (LONG_PRESS_EVENT << 0)
#define RIGHT_BUTTON_LONG_EVENT     (LONG_PRESS_EVENT << 1)
#define SELECT_BUTTON_LONG_EVENT    (LONG_PRESS_EVENT << 2)
#define BUTTON_LONG_EVENTS_ALL      (LEFT_BUTTON_LONG_EVENT | \
                                     RIGHT_BUTTON_LONG_EVENT | \
                                     SELECT_BUTTON_LONG_EVENT)

#define SOFT_SHUTDOWN_EVENT         (LEFT_BUTTON_LONG_EVENT | \
                                     RIGHT_BUTTON_LONG_EVENT)

#define BAT_CHARGING_STATE_CHANGE_EVENT  (1 << 0)

extern struct k_event gpio_events;

extern struct k_event power_events;

#endif /* CONTROLLER_H */
```

## inc/environ.h
```c
#ifndef ENVIRON_H
#define ENVIRON_H

#include <zephyr/kernel.h>
#include <zephyr/drivers/sensor.h>

struct environ_data {
    struct sensor_value temp;
    struct sensor_value press;
    struct sensor_value humidity;
    struct sensor_value gas_res;
    struct sensor_value vis_light;
    struct sensor_value ir_light;
    struct sensor_value uv_index;
};

extern struct k_msgq environ_data_msgq;

// extern const k_id_t environ_id; // NOTE: If thread reference required, uncomment

#endif /* ENVIRON_H */
```

## inc/file_helpers.h
```c
#ifndef FILE_HELPERS_H
#define FILE_HELPERS_H

#include <zephyr/fs/fs.h>
#include <zephyr/bluetooth/uuid.h>

struct location {
    uint8_t x;
    uint8_t y;
    uint8_t z;
};


int initialise_files(struct fs_mount_t *);

int search_directory(struct fs_dir_t *, char *, char *);

int find_network_file(const struct bt_uuid *);

int find_beacon(char *, uint16_t, uint16_t, struct location *);

int test_searching(uint16_t, uint16_t);

int bt_uuid_from_str(char *, struct bt_uuid *);

int is_supported_network(const struct bt_uuid *);

#endif /* FILE_HELPERS_H */
```

## inc/gnss.h
```c
#ifndef GNSS_H
#define GNSS_H

#include <zephyr.h>

/* Event to toggle printing the GNSS NMEA sentences to console */
#define GNSS_TOGGLE_DEBUG_OUTPUT   (1 << 0)

/* Controls behaviour of the GNSS module */
extern struct k_event gnss_control_events;

#endif /* GNSS_H */
```

## inc/imu.h
```c
#ifndef IMU_H
#define IMU_H

#include <zephyr/kernel.h>
#include <zephyr/drivers/sensor.h>

enum activity {
    ACTIVITY_UNDEFINED = 0,
    ACTIVITY_STAND,
    ACTIVITY_WALK,
    ACTIVITY_RUN,
    ACTIVITY_JUMP
};

struct imu_data {
    struct sensor_value accel_x;
    struct sensor_value accel_y;
    struct sensor_value accel_z;
    struct sensor_value gyro_x;
    struct sensor_value gyro_y;
    struct sensor_value gyro_z;
};

extern struct k_msgq activity_msgq;

#endif /* IMU_H */
```

## inc/location.h
```c
#ifndef LOCATION_H
#define LOCATION_H

#include <zephyr/kernel.h>

enum location_source {
    LOCATION_BLE = 0,
    LOCATION_GNSS,
};

/**
 * @brief A location
 */
struct location {
    float latitude;
    float longitude;
    float altitude;
};

struct location_wrapper {
    enum location_source source;
    struct location location;
};

extern struct k_msgq location_msgq;

/**
 * @brief Converts the given measurement from a float into an int32 given in 
 *        1e6 degrees.
 * 
 * @param measurement Measurement to convert
 * @return measurement in units of 1e6 degrees
 */
inline int32_t location_float_to_int32(float measurement) {
    return (int32_t)(measurement * 10 * 6);
}

#endif /* LOCATION_H */
```

## src/accumulator.c
```c
#include <zephyr/kernel.h>
#include <zephyr/logging/log.h>

#include "accumulator.h"
#include "environ.h"
#include "imu.h"
#include "location.h"

LOG_MODULE_REGISTER(accumulator);


#define ACCUMULATOR_STACK_SIZE  2048
#define ACCUMULATOR_PRIORITY    6

/* Only send environ tracker data packets every 30s */
#define LORAWAN_SEND_PERIOD     30 * 1000

/* Create the message queue for the GUI backend */
K_MSGQ_DEFINE(gui_msgq, sizeof(struct system_data), 5, 4);

/* Create the message queue for the LoRaWAN backend */
K_MSGQ_DEFINE(lorawan_msgq, sizeof(struct system_data), 5, 4);

/* Create message queue to receive location data from */
K_MSGQ_DEFINE(location_msgq, sizeof(struct location_wrapper), 5, 4);

/* Input data pending event group */
K_EVENT_DEFINE(data_events);


/**
 * @brief Thread to accumulate and aggregate all system data to then forward to
 *        LoRaWAN send and OLED display threads as required.
 */
void accumulator_thread(void *a, void *b, void *c)
{
    struct system_data sys_data = {0};
    int64_t last_lorawan_send = 0;
    uint32_t events;
    int err;
    

    LOG_INF("Accumulator started");


    while (1) {
        /* Wait for all data to be ready */
        events = k_event_wait(&data_events, ENVIRON_DATA_PENDING |
                LOCATION_DATA_PENDING, false, K_SECONDS(10));

        if (events & ENVIRON_DATA_PENDING) {
            k_event_set_masked(&data_events, 0, ENVIRON_DATA_PENDING);

            err = k_msgq_get(&environ_data_msgq, &sys_data.environ, K_NO_WAIT);
            if (err != 0) {
                LOG_ERR("environ data receive error: %d", err);
                continue;
            }
        } else if (events & LOCATION_DATA_PENDING) {
            k_event_set_masked(&data_events, 0, LOCATION_DATA_PENDING);

            err = k_msgq_get(&location_msgq, &sys_data.location, K_NO_WAIT);
            if (err != 0) {
                LOG_ERR("location receive error: %d", err);
                continue;
            }
        }

        LOG_DBG("Sending sys_data");

        /* Some data has changed, so send it onwards */
        if (events) {
            /* Send to lorawan_thread */
            if ((k_uptime_get() - last_lorawan_send) > LORAWAN_SEND_PERIOD) {
                last_lorawan_send = k_uptime_get();
                
                while (k_msgq_put(&lorawan_msgq, &sys_data, K_MSEC(2)) != 0) {
                    k_msgq_purge(&lorawan_msgq);
                    LOG_DBG("lorawan_msgq has been purged");
                }
            }

            /* Send to GUI thread */
            while (k_msgq_put(&gui_msgq, &sys_data, K_MSEC(2)) != 0) {
                k_msgq_purge(&gui_msgq);
                LOG_DBG("gui_msgq has been purged");
            }
        }
    }
}

K_THREAD_DEFINE(accumulator_id, ACCUMULATOR_STACK_SIZE, accumulator_thread, NULL, NULL, NULL, ACCUMULATOR_PRIORITY, 0, 0);
```

## src/ble_localisation.c
```c
#include "ble_localisation.h"

#include <zephyr.h>
#include <kernel.h>

#include <bluetooth/bluetooth.h>
#include <bluetooth/hci.h>
#include <bluetooth/uuid.h>

#include <sys/byteorder.h>

#include <logging/log.h>

LOG_MODULE_REGISTER(ble_localisation, LOG_LEVEL_INF);


#define MAX_LOCALISATION_BEACONS    16

#define SCAN_PERIOD     5000
#define MAX_MISSED_SCAN_PERIODS 5

#define BLE_LOCALISATION_STACK_SIZE 1024
#define BLE_LOCALISATION_PRIORITY   5

/* This delay is so that BLE logs can be seen from the shell */
#define BLE_LOCALISATION_STARTUP_DELAY 500

/* NOTE: This is currently the only supported iBeacon network UUID */
static const struct bt_uuid_128 supported_beacon_network = BT_UUID_INIT_128(
        BT_UUID_128_ENCODE(0x7aaf1b67, 0xf3c0, 0x4a54, 0xb314, 0x58fff1960a40));

/* Stores all required ibeacon data */
struct ibeacon_data {
    int64_t discovered_time;
    struct bt_uuid_128 uuid; 
    uint16_t major;
    uint16_t minor;
    int8_t tx_power;
    int8_t rssi;
    sys_snode_t next;
};

/* Scan parameters for BLE advertisement scanning */
static const struct bt_le_scan_param scan_params = {
        .type = BT_HCI_LE_SCAN_PASSIVE,
        .options = BT_LE_SCAN_OPT_NONE,
        .interval = BT_GAP_SCAN_FAST_INTERVAL,
        .window = BT_GAP_SCAN_FAST_WINDOW
};

/* List to append ibeacon data to */
static sys_slist_t ibeacon_list;

/* Mutex to protect access to ibeacon_list */
K_MUTEX_DEFINE(ibeacon_list_mutex);

/* Memory slab to allocate ibeacon data from */
K_MEM_SLAB_DEFINE_STATIC(ibeacon_mem, sizeof(struct ibeacon_data), 
        MAX_LOCALISATION_BEACONS, 4);


static void empty_ibeacon_list(void)
{
    struct ibeacon_data *beacon;
    struct sys_snode_t *node;

    k_mutex_lock(&ibeacon_list_mutex, K_MSEC(1));
    while ((node = sys_slist_get(&ibeacon_list)) != NULL) {
        beacon = SYS_SLIST_CONTAINER(node, beacon, next);

        k_mem_slab_free(&ibeacon_mem, &beacon);
    }
    k_mutex_unlock(&ibeacon_list_mutex);
}

/**
 * @brief Parses the input data to see if it is an iBeacon packet. If it is,
 *        then fill the user_data struct. If it isn't set user_data to NULL.
 */
static bool parse_ad(struct bt_data *data, void *user_data)
{
    struct ibeacon_data *ad_data = user_data;
    int ret;
 
    /* 
     * iBeacon has a BT_DATA_FLAGS and BT_DATA_MANUFACTURER section, so allow
     * the parser to check the next section 
     */
    if (data->type == BT_DATA_FLAGS)
        return true;

    /* iBeacons only have manufacturer data with data length 25 */
    if (data->type != BT_DATA_MANUFACTURER_DATA || data->data_len != 25) {
        user_data = NULL;
        return false;
    }

    /* iBeacons packets always start with 0x004c0215 */
    if (sys_cpu_to_be32(((uint32_t *)data->data)[0]) != 0x004c0215) {
        user_data = NULL;
        return false;
    }

    /* Save UUID in correct endianness */
    sys_mem_swap(&data->data[4], 16);
    ret = bt_uuid_create(&ad_data->uuid.uuid, &data->data[4], 16);
    if (!ret) {
        user_data = NULL;
        return false;
    }

    /* Ensure endianness */
    ad_data->major = sys_cpu_to_be16(*(uint16_t *)&data->data[20]);
    ad_data->minor = sys_cpu_to_be16(*(uint16_t *)&data->data[22]);
    ad_data->tx_power = data->data[24];

    LOG_DBG("maj: %d, min: %d, tx: %d", ad_data->major, ad_data->minor, ad_data->tx_power);

    return false;
}

/**
 * @brief Callback for when a BLE advertisement is scanned. Checks if the 
 *        packet is an iBeacon packet and sends it to the queue if it is.
 */
static void scan_cb(const bt_addr_le_t *addr, int8_t rssi, uint8_t adv_type, 
        struct net_buf_simple *ad)
{
    struct ibeacon_data *beacon_data, *tmp, beacon_data_tmp;
    int ret;

    beacon_data = &beacon_data_tmp;

    /* Only want non-connectable and non-scannable advertisements (iBeacon) */
    if (adv_type != BT_GAP_ADV_TYPE_ADV_NONCONN_IND || rssi < -70)
        return;

    /* Parse the data to see if it is an iBeacon */
    bt_data_parse(ad, parse_ad, beacon_data);    
    if (beacon_data == NULL)
        return;

    /* Save RSSI and the time the packet was received */
    beacon_data->rssi = rssi;
    beacon_data->discovered_time = k_uptime_get();

    /* 
     * See if the network is supported (by checking the UUID), if it is then 
     * the beacon should be in the database 
    */
    if (bt_uuid_cmp(&supported_beacon_network.uuid, &beacon_data->uuid) != 0)
        return;

    /* Check if the ibeacon is already in the list */
    k_mutex_lock(&ibeacon_list_mutex, K_NO_WAIT);
    SYS_SLIST_FOR_EACH_CONTAINER(&ibeacon_list, tmp, next) {
        
        if (beacon_data->major == tmp->major && 
                beacon_data->minor == tmp->minor) {

            k_mutex_unlock(&ibeacon_list_mutex);
            return;
        }
    }

    // DEBUG
    LOG_INF("New iBeacon");

    // TODO: Maybe handle a non-alloc better??
    ret = k_mem_slab_alloc(&ibeacon_mem, &beacon_data, K_NO_WAIT);
    if (ret != 0) {
        LOG_ERR("Beacon packet couldn't be allocated (ret %d)", ret);

        k_mutex_unlock(&ibeacon_list_mutex);
        return;
    }

    memcpy(beacon_data, &beacon_data_tmp, sizeof(struct ibeacon_data));

    /* ibeacon wasn't in the list, so append it */
    sys_slist_append(&ibeacon_list, &beacon_data->next);
    k_mutex_unlock(&ibeacon_list_mutex);
}

/**
 * @brief Restarts BLE advertisement scanning
 */
void scan_restart_work_handler(struct k_work *work)
{
    LOG_INF("Scan restart timer elapsed, restarting iBeacon scanning");

    bt_le_scan_start(&scan_params, scan_cb);
    k_thread_resume(ble_localisation_id);
}

/* Defines the k_work to restart scanning */
K_WORK_DEFINE(scan_restart, scan_restart_work_handler);

/**
 * @brief Timer callback to restart BLE scanning
 */
static void scan_restart_handler(struct k_timer *timer)
{
    k_work_submit(&scan_restart);
}

/* Timer to restart scanning */
K_TIMER_DEFINE(scan_restart_timer, scan_restart_handler, NULL);

/**
 * @brief Thread to perform localisation using iBeacons 
 */
void ble_localisation(void *a, void *b, void *c)
{
    int ret, beacons_found = 0, missed_scans = 0;
    struct ibeacon_data *beacon;
    struct sys_snode_t *node;

    sys_slist_init(&ibeacon_list);

    ret = bt_enable(NULL);
    if (ret) {
        LOG_ERR("Bluetooth init failed (err %d)", ret);
        return;
    }

    LOG_DBG("Bluetooth initialised");

    ret = bt_le_scan_start(&scan_params, scan_cb);
    if (ret) {
        LOG_ERR("BLE scanning failed (err %d)", ret);
        return;
    }

    while (1) {
        k_msleep(SCAN_PERIOD);

        LOG_WRN("Scan period elapsed. Missed scans %d", missed_scans);

        /* If enough beacons have been found then run the localisation algo */
        beacons_found = k_mem_slab_num_used_get(&ibeacon_mem);
        if (beacons_found < 3) {
            ++missed_scans;

            /* Missed too many scans. Stop scanning for 10 minutes */
            if (missed_scans >= MAX_MISSED_SCAN_PERIODS) {

                bt_le_scan_stop();

                /* Scanning stopped, so empty the list */
                empty_ibeacon_list();

                k_timer_start(&scan_restart_timer, K_MINUTES(10), K_FOREVER);

                LOG_INF("Missed %d scanning periods, stopped iBeacon "
                        "scanning and suspending", missed_scans);

                k_thread_suspend(ble_localisation_id);

                missed_scans = 0;
            }
        } else {
            missed_scans = 0;

            k_mutex_lock(&ibeacon_list_mutex, K_MSEC(1));
            while ((node = sys_slist_get(&ibeacon_list)) != NULL) {
                beacon = SYS_SLIST_CONTAINER(node, beacon, next);
                
                // DEBUG
                LOG_INF("Beacon major: %u, minor %u, rssi %d", beacon->major, 
                        beacon->minor, beacon->rssi);
                
                // TODO: Find a position estimate

                k_mem_slab_free(&ibeacon_mem, &beacon);
            }
            k_mutex_unlock(&ibeacon_list_mutex);
        }
    }
}

K_THREAD_DEFINE(ble_localisation_id, BLE_LOCALISATION_STACK_SIZE, 
        ble_localisation, NULL, NULL, NULL, BLE_LOCALISATION_PRIORITY, 
        0, BLE_LOCALISATION_STARTUP_DELAY);
```

## src/controller.c
```c
#include <zephyr/kernel.h>
#include <zephyr/device.h>
#include <zephyr/drivers/gpio.h>
#include <zephyr/logging/log.h>

#include "file/file_common.h"
#include "file/file_init.h"
#include "controller.h"

LOG_MODULE_REGISTER(controller);


#define CONTROLLER_STACK_SIZE  2048
#define CONTROLLER_PRIORITY    3


/* Event for button GPIO events */
K_EVENT_DEFINE(gpio_events);

/* Event for power events */
K_EVENT_DEFINE(power_events);


/**
 * @brief Increment the systems boot counter
 * 
 * @return 0 on success, else negative error code from FS API
 */
int increment_boot_count(void)
{
    uint32_t boot_count = 0;
    int err;

    err = read_file("boot_count", (uint8_t *)&boot_count, sizeof(boot_count));
    if (err == -EEXIST) {
        boot_count = 0;
    } else if (err != 0) {
        return err;
    } else {
        LOG_INF("boot_count is: %d", boot_count);
        ++boot_count;
    }

    err = write_file("boot_count", (uint8_t *)&boot_count, sizeof(boot_count));
    
    return err;
}

/**
 * @brief Thread to control miscellaneous tasks
 */
void controller_thread(void *a, void *b, void *c)
{
    LOG_INF("Controller started");

    #ifdef CONFIG_APP_INIT_BEACON_FILES
    initialise_files();
    #endif /* CONFIG_APP_INIT_BEACON_FILES */

    increment_boot_count();


    while (1) {
        k_msleep(100);
    }
}

K_THREAD_DEFINE(controller_id, CONTROLLER_STACK_SIZE, controller_thread, NULL,
        NULL, NULL, CONTROLLER_PRIORITY, 0, 0);
```

## src/environ.c
```c
#include <zephyr/kernel.h>
#include <zephyr/device.h>
#include <zephyr/drivers/sensor.h>
#include <zephyr/logging/log.h>

#include "environ.h"
#include "accumulator.h"

LOG_MODULE_REGISTER(environ_fetch);


#define ENVIRON_STACK_SIZE  500
#define ENVIRON_PRIORITY    5

#define ENVIRON_DATA_PERIOD 3000


K_MSGQ_DEFINE(environ_data_msgq, sizeof(struct environ_data), 10, 4);


/**
 * @brief Fetches all environmental sensor data and sends onwards
 */
void environ_fetch_thread(void *a, void *b, void *c)
{
    struct environ_data data = {0};

    const struct device *bme680_dev = DEVICE_DT_GET_ONE(bosch_bme680);
    const struct device *si1132_dev = DEVICE_DT_GET_ONE(silabs_si1132);

    if (!device_is_ready(bme680_dev)) {
        LOG_ERR("%s: device not ready.", bme680_dev->name);
        return;
    } else if (!device_is_ready(si1132_dev)) {
        LOG_ERR("%s: device not ready.", si1132_dev->name);         
        return;
    }

    LOG_DBG("Device %p name is %s", bme680_dev, bme680_dev->name);
    LOG_DBG("Device %p name is %s", si1132_dev, si1132_dev->name);


    while (1) {
        k_msleep(ENVIRON_DATA_PERIOD);
    
        /* Fetch all sensor channels */
        sensor_sample_fetch(bme680_dev);
        sensor_sample_fetch(si1132_dev);

        /* Get all channel values */
        sensor_channel_get(bme680_dev, SENSOR_CHAN_AMBIENT_TEMP, &data.temp);
        sensor_channel_get(bme680_dev, SENSOR_CHAN_PRESS, &data.press);
        sensor_channel_get(bme680_dev, SENSOR_CHAN_HUMIDITY, &data.humidity);
        sensor_channel_get(bme680_dev, SENSOR_CHAN_GAS_RES, &data.gas_res);
        
        sensor_channel_get(si1132_dev, SENSOR_CHAN_LIGHT, &data.vis_light);
        sensor_channel_get(si1132_dev, SENSOR_CHAN_IR, &data.ir_light);
        sensor_channel_get(si1132_dev, SENSOR_CHAN_RED, &data.uv_index);

        LOG_DBG("T: %d.%06d; P: %d.%06d; H: %d.%06d; G: %d.%06d; "
                "L: %d; IR: %d; UV: %d.%06d", data.temp.val1, 
                data.temp.val2, data.press.val1, data.press.val2, 
                data.humidity.val1, data.humidity.val2, data.gas_res.val1, 
                data.gas_res.val2, data.vis_light.val1, data.ir_light.val1,
                data.uv_index.val1, data.uv_index.val2);

        /* Send environmental data */
        while (k_msgq_put(&environ_data_msgq, &data, K_NO_WAIT) != 0) {
            /* message queue is full: purge old data & try again */
            k_msgq_purge(&environ_data_msgq);
            LOG_DBG("environ_data_msgq has been purged");
        }

        k_event_post(&data_events, ENVIRON_DATA_PENDING);
    }
}

K_THREAD_DEFINE(environ_id, ENVIRON_STACK_SIZE, environ_fetch_thread, 
        NULL, NULL, NULL, ENVIRON_PRIORITY, 0, 0);
```
